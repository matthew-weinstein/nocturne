## components/audio/Kconfig
```kconfig
menu "Nocturne audio"

    choice NOCTURNE_OPUS_APPLICATION
        prompt "Opus application mode"
        default NOCTURNE_OPUS_APPLICATION_AUDIO

        config NOCTURNE_OPUS_APPLICATION_AUDIO
            bool "Audio (preserves non-speech detail)"

        config NOCTURNE_OPUS_APPLICATION_VOIP
            bool "VOIP (speech-tuned, lower CPU)"

    endchoice

    config NOCTURNE_OPUS_BITRATE
        int "Opus bitrate (bps)"
        default 32000
        range 8000 64000

endmenu
```

## components/crypto/host_test/sdkconfig.defaults
```kconfig
CONFIG_IDF_TARGET="linux"
CONFIG_UNITY_ENABLE_IDF_TEST_RUNNER=n
CONFIG_MBEDTLS_SHA1_C=y
```

## components/network/Kconfig
```kconfig
menu "Nocturne network"

    config NOCTURNE_SNTP_SERVER
        string "SNTP server"
        default "pool.ntp.org"

    config NOCTURNE_TIMEZONE
        string "Timezone (POSIX TZ string)"
        default "UTC0"
        help
            Session IDs use local time in this zone, e.g. "GMT0BST,M3.5.0/1,M10.5.0"
            for the UK or "EST5EDT,M3.2.0,M11.1.0" for US Eastern.

endmenu
```

## components/storage/Kconfig
```kconfig
menu "Nocturne storage"

    config NOCTURNE_SEGMENT_SECONDS
        int "Segment length (seconds)"
        default 300
        range 5 3600

    config NOCTURNE_RESUME_WINDOW_MINUTES
        int "Resume window (minutes)"
        default 60
        range 1 120
        help
            An interrupted session whose journal was last written within
            this window is resumed at boot; an older one is finished.

    config NOCTURNE_RETENTION_DAYS
        int "Retention on the card (days)"
        default 7
        range 0 365
        help
            A session that is fully in B2 is deleted from the card once its
            journal was last written this many days ago, or sooner, oldest
            first, while the card is more than 80 % full. 0 deletes a session
            at the first cleanup after its session.json is uploaded.

endmenu
```

## main/Kconfig.projbuild
```kconfig
menu "Nocturne"

    config NOCTURNE_SYSTEM_CHECK
        bool "Check the recorded session after a short capture"
        default n

    config NOCTURNE_SYSTEM_CHECK_CAPTURE_SECONDS
        int "System-check capture length (seconds)"
        default 35
        depends on NOCTURNE_SYSTEM_CHECK
        range 5 28800

    config NOCTURNE_SYSTEM_CHECK_WIFI_OUTAGE_SECONDS
        int "System-check WiFi outage, centred on the health check (seconds, 0 for none)"
        default 0
        depends on NOCTURNE_SYSTEM_CHECK
        range 0 3600

    choice NOCTURNE_SYSTEM_CHECK_FAULT
        prompt "System-check fault to inject"
        default NOCTURNE_SYSTEM_CHECK_FAULT_NONE
        depends on NOCTURNE_SYSTEM_CHECK
        help
            One failure from the failure matrix, induced during the
            system-check capture through link-time wrappers. Any fault but
            none skips the session and upload checks; the system test reads
            the response from the log.

        config NOCTURNE_SYSTEM_CHECK_FAULT_NONE
            bool "None"
        config NOCTURNE_SYSTEM_CHECK_FAULT_CARD_FULL
            bool "Card reads 3 % free"
        config NOCTURNE_SYSTEM_CHECK_FAULT_SD_WRITE_GLITCH
            bool "One card write fails"
        config NOCTURNE_SYSTEM_CHECK_FAULT_SD_WRITE_ERROR
            bool "A card write fails every retry"
        config NOCTURNE_SYSTEM_CHECK_FAULT_MIC_SILENT
            bool "Mic delivers only zeros"
        config NOCTURNE_SYSTEM_CHECK_FAULT_ENCODER_ERROR
            bool "One frame fails to encode"
        config NOCTURNE_SYSTEM_CHECK_FAULT_ENCODER_STALL
            bool "The encoder stalls for 1 s"
        config NOCTURNE_SYSTEM_CHECK_FAULT_RECORDER_HANG
            bool "The encoder never returns"
        config NOCTURNE_SYSTEM_CHECK_FAULT_UPLOAD_FAILING
            bool "Every upload fails"
        config NOCTURNE_SYSTEM_CHECK_FAULT_WIFI_DOWN_AT_START
            bool "WiFi down from before recording until the stop"
    endchoice

endmenu
```

## sdkconfig.defaults
```kconfig
CONFIG_IDF_TARGET="esp32s3"

CONFIG_ESPTOOLPY_FLASHSIZE_16MB=y
CONFIG_PARTITION_TABLE_CUSTOM=y
CONFIG_PARTITION_TABLE_CUSTOM_FILENAME="partitions.csv"

CONFIG_SPIRAM=y
CONFIG_SPIRAM_MODE_OCT=y
CONFIG_SPIRAM_SPEED_40M=y

CONFIG_ESP_DEFAULT_CPU_FREQ_MHZ_240=y
CONFIG_ESP_MAIN_TASK_STACK_SIZE=8192
CONFIG_FREERTOS_HZ=100

CONFIG_FATFS_LFN_HEAP=y

CONFIG_MBEDTLS_CERTIFICATE_BUNDLE=y
CONFIG_MBEDTLS_SHA1_C=y

CONFIG_OPUS_FLOATING_POINT=n
CONFIG_OPUS_STATE_PREFER_PSRAM=y
CONFIG_OPUS_PSEUDOSTACK_PREFER_PSRAM=y
```

## test_app/sdkconfig.defaults
```kconfig
CONFIG_PARTITION_TABLE_CUSTOM_FILENAME="../partitions.csv"
CONFIG_NOCTURNE_SEGMENT_SECONDS=10
CONFIG_ESP_CONSOLE_USB_SERIAL_JTAG=y
CONFIG_ESP_TASK_WDT_CHECK_IDLE_TASK_CPU0=n
```
